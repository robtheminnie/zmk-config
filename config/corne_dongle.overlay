/ {
    /* Define dummy encoder nodes just to satisfy label references */
    left_encoder: encoder_left {
        compatible = "zmk,encoder";
        status = "disabled";
    };

    right_encoder: encoder_right {
        compatible = "zmk,encoder";
        status = "disabled";
    };

    /* Override the sensors node so it doesn’t bind to those encoders */
    sensors {
        compatible = "zmk,sensors";
        status = "disabled";
    };
};
