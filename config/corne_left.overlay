/ {
        right_encoder: right_encoder {
                compatible = "alps,ec11";
                a-gpios = <&pro_micro 16 (GPIO_ACTIVE_HIGH | GPIO_PULL_UP)>;
                b-gpios = <&pro_micro 10 (GPIO_ACTIVE_HIGH | GPIO_PULL_UP)>;
                steps = <80>;
                status = "disabled";
        };
        left_encoder: left_encoder {
                compatible = "alps,ec11";
                a-gpios = <&pro_micro 16 (GPIO_ACTIVE_HIGH | GPIO_PULL_UP)>;
                b-gpios = <&pro_micro 10 (GPIO_ACTIVE_HIGH | GPIO_PULL_UP)>;
                steps = <80>;
                status = "okay";
        };
};

&nice_view_spi { cs-gpios = <&pro_micro 8 GPIO_ACTIVE_HIGH>; };
