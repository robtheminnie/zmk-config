## boards/shields/corne/Kconfig.shield
```kconfig
# No whitespace after the comma or in the keyboard name!
config corne_dongle
    def_bool $(shields_list_contains,corne_dongle)
```

## boards/shields/my_corne/Kconfig.shield
```kconfig
# No whitespace after the comma or in the keyboard name!
config my_corne_dongle
    def_bool $(shields_list_contains,my_corne_dongle)
```
